CM_ "AUTOGENERATED FILE, DO NOT EDIT";

CM_ "hyundai_kia_mando_corner_radar.dbc starts here";

VERSION ""

NS_ :

BS_:

BU_: XXX

BO_ 256 RADAR_POINTS_METADATA_0x100: 64 RADAR
 SG_ SIGNAL_1 : 0|32@1+ (1,0) [0|255] "" XXX
 SG_ SIGNAL_2 : 32|32@1+ (1,0) [0|65535] "" XXX
 SG_ SIGNAL_3 : 64|4@1+ (1,0) [0|15] "" XXX
 SG_ SIGNAL_4 : 68|4@1+ (1,0) [0|15] "" XXX
 SG_ RADAR_POINT_COUNT : 72|8@1+ (1,0) [0|255] "" XXX
 SG_ SIGNAL_6 : 80|7@1+ (0.015625,0) [0|3] "" XXX
 SG_ SIGNAL_7 : 87|1@1+ (1,0) [0|1] "" XXX
 SG_ SIGNAL_8 : 88|3@1+ (1,0) [0|7] "" XXX
 SG_ SIGNAL_9 : 91|5@1+ (0.0625,0) [0|31] "" XXX
 SG_ SIGNAL_10 : 96|8@1+ (1,0) [0|255] "" XXX
 SG_ SIGNAL_11 : 104|7@1+ (0.015625,0) [0|127] "" XXX
 SG_ SIGNAL_12 : 111|2@1+ (1,0) [0|65535] "" XXX
 SG_ SIGNAL_13 : 113|7@1+ (0.015625,0) [0|127] "" XXX
 SG_ SIGNAL_14 : 120|7@1+ (0.015625,0) [0|127] "" XXX
 SG_ SIGNAL_15 : 127|3@1+ (1,0) [0|3] "" XXX
 SG_ SIGNAL_16 : 130|2@1+ (1,0) [0|3] "" XXX
 SG_ SIGNAL_17 : 133|2@0+ (1,0) [0|3] "" XXX
 SG_ SIGNAL_18 : 134|1@0+ (1,0) [0|3] "" XXX
 SG_ SIGNAL_19 : 135|3@1+ (1,0) [0|3] "" XXX
 SG_ SIGNAL_20 : 138|8@1+ (1,0) [0|63] "" XXX
 SG_ SIGNAL_21 : 146|2@1+ (1,0) [0|3] "" XXX
 SG_ SIGNAL_22 : 148|1@1+ (1,0) [0|3] "" XXX
 SG_ SIGNAL_23 : 149|4@1+ (1,0) [0|7] "" XXX
 SG_ SIGNAL_24 : 153|1@1+ (1,0) [0|3] "" XXX
 SG_ SIGNAL_25 : 154|2@1+ (1,0) [0|3] "" XXX
 SG_ SIGNAL_26 : 157|2@0+ (1,0) [0|3] "" XXX
 SG_ SIGNAL_27 : 158|7@1+ (0.125,0) [0|3] "" XXX
 SG_ SIGNAL_28 : 165|7@1+ (0.015625,0) [0|31] "" XXX
 SG_ SIGNAL_29 : 172|7@1+ (0.125,0) [0|3] "" XXX
 SG_ SIGNAL_30 : 179|7@1+ (0.015625,0) [0|1] "" XXX
 SG_ SIGNAL_31 : 186|4@1+ (1,0) [0|7] "" XXX
 SG_ SIGNAL_32 : 190|14@1+ (0.015625,0) [0|15] "" XXX
 SG_ SIGNAL_33 : 204|11@1+ (0.03125,0) [0|8191] "" XXX
 SG_ SIGNAL_34 : 215|2@1+ (1,0) [0|3] "" XXX
 SG_ SIGNAL_35 : 217|7@1+ (1,0) [0|127] "" XXX
 SG_ SIGNAL_36 : 224|6@1+ (1,0) [0|63] "" XXX
 SG_ SIGNAL_37 : 230|6@1+ (0.2,0) [0|31] "" XXX
 SG_ SIGNAL_38 : 236|6@1+ (0.2,0) [0|7] "" XXX
 SG_ SIGNAL_39 : 242|8@1+ (1,-90) [0|255] "" XXX
 SG_ SIGNAL_40 : 250|6@1+ (1,0) [0|63] "" XXX
 SG_ SIGNAL_41 : 256|8@1+ (0.25,0) [0|255] "" XXX
 SG_ SIGNAL_42 : 264|3@1+ (1,0) [0|3] "" XXX
 SG_ SIGNAL_43 : 267|12@1+ (0.01,0) [0|31] "" XXX
 SG_ SIGNAL_44 : 279|32@1+ (1,0) [0|63] "" XXX
 SG_ SIGNAL_45 : 311|1@1+ (1,0) [0|1] "" XXX
 SG_ SIGNAL_46 : 312|2@1+ (1,0) [0|3] "" XXX
 SG_ SIGNAL_47 : 314|32@1+ (1,0) [0|255] "" XXX
 SG_ SIGNAL_48 : 346|6@1+ (1,0) [0|63] "" XXX
 SG_ SIGNAL_49 : 352|7@1+ (0.25,0) [0|127] "" XXX
 SG_ SIGNAL_50 : 359|6@1+ (0.03125,0) [0|31] "" XXX
 SG_ SIGNAL_51 : 365|10@1+ (0.125,0) [0|3] "" XXX
 SG_ SIGNAL_52 : 375|10@1+ (0.125,0) [0|63] "" XXX
 SG_ SIGNAL_53 : 385|7@1+ (1,0) [0|127] "" XXX
 SG_ SIGNAL_54 : 392|7@1+ (1,0) [0|127] "" XXX
 SG_ SIGNAL_55 : 399|8@1+ (0.00390625,0) [0|31] "" XXX
 SG_ SIGNAL_56 : 407|10@1+ (0.125,0) [0|63] "" XXX
 SG_ SIGNAL_57 : 417|1@1+ (1,0) [0|3] "" XXX
 SG_ SIGNAL_58 : 418|1@1+ (1,0) [0|3] "" XXX

BO_ 512 RADAR_POINTS_METADATA_0x200: 64 RADAR
 SG_ SIGNAL_1 : 0|32@1+ (1,0) [0|255] "" XXX
 SG_ SIGNAL_2 : 32|32@1+ (1,0) [0|65535] "" XXX
 SG_ SIGNAL_3 : 64|4@1+ (1,0) [0|15] "" XXX
 SG_ SIGNAL_4 : 68|4@1+ (1,0) [0|15] "" XXX
 SG_ RADAR_POINT_COUNT : 72|8@1+ (1,0) [0|255] "" XXX
 SG_ SIGNAL_6 : 80|7@1+ (0.015625,0) [0|3] "" XXX
 SG_ SIGNAL_7 : 87|1@1+ (1,0) [0|1] "" XXX
 SG_ SIGNAL_8 : 88|3@1+ (1,0) [0|7] "" XXX
 SG_ SIGNAL_9 : 91|5@1+ (0.0625,0) [0|31] "" XXX
 SG_ SIGNAL_10 : 96|8@1+ (1,0) [0|255] "" XXX
 SG_ SIGNAL_11 : 104|7@1+ (0.015625,0) [0|127] "" XXX
 SG_ SIGNAL_12 : 111|2@1+ (1,0) [0|65535] "" XXX
 SG_ SIGNAL_13 : 113|7@1+ (0.015625,0) [0|127] "" XXX
 SG_ SIGNAL_14 : 120|7@1+ (0.015625,0) [0|127] "" XXX
 SG_ SIGNAL_15 : 127|3@1+ (1,0) [0|3] "" XXX
 SG_ SIGNAL_16 : 130|2@1+ (1,0) [0|3] "" XXX
 SG_ SIGNAL_17 : 133|2@0+ (1,0) [0|3] "" XXX
 SG_ SIGNAL_18 : 134|1@0+ (1,0) [0|3] "" XXX
 SG_ SIGNAL_19 : 135|3@1+ (1,0) [0|3] "" XXX
 SG_ SIGNAL_20 : 138|8@1+ (1,0) [0|63] "" XXX
 SG_ SIGNAL_21 : 146|2@1+ (1,0) [0|3] "" XXX
 SG_ SIGNAL_22 : 148|1@1+ (1,0) [0|3] "" XXX
 SG_ SIGNAL_23 : 149|4@1+ (1,0) [0|7] "" XXX
 SG_ SIGNAL_24 : 153|1@1+ (1,0) [0|3] "" XXX
 SG_ SIGNAL_25 : 154|2@1+ (1,0) [0|3] "" XXX
 SG_ SIGNAL_26 : 157|2@0+ (1,0) [0|3] "" XXX
 SG_ SIGNAL_27 : 158|7@1+ (0.125,0) [0|3] "" XXX
 SG_ SIGNAL_28 : 165|7@1+ (0.015625,0) [0|31] "" XXX
 SG_ SIGNAL_29 : 172|7@1+ (0.125,0) [0|3] "" XXX
 SG_ SIGNAL_30 : 179|7@1+ (0.015625,0) [0|1] "" XXX
 SG_ SIGNAL_31 : 186|4@1+ (1,0) [0|7] "" XXX
 SG_ SIGNAL_32 : 190|14@1+ (0.015625,0) [0|15] "" XXX
 SG_ SIGNAL_33 : 204|11@1+ (0.03125,0) [0|8191] "" XXX
 SG_ SIGNAL_34 : 215|2@1+ (1,0) [0|3] "" XXX
 SG_ SIGNAL_35 : 217|7@1+ (1,0) [0|127] "" XXX
 SG_ SIGNAL_36 : 224|6@1+ (1,0) [0|63] "" XXX
 SG_ SIGNAL_37 : 230|6@1+ (0.2,0) [0|31] "" XXX
 SG_ SIGNAL_38 : 236|6@1+ (0.2,0) [0|7] "" XXX
 SG_ SIGNAL_39 : 242|8@1+ (1,-90) [0|255] "" XXX
 SG_ SIGNAL_40 : 250|6@1+ (1,0) [0|63] "" XXX
 SG_ SIGNAL_41 : 256|8@1+ (0.25,0) [0|255] "" XXX
 SG_ SIGNAL_42 : 264|3@1+ (1,0) [0|3] "" XXX
 SG_ SIGNAL_43 : 267|12@1+ (0.01,0) [0|31] "" XXX
 SG_ SIGNAL_44 : 279|32@1+ (1,0) [0|63] "" XXX
 SG_ SIGNAL_45 : 311|1@1+ (1,0) [0|1] "" XXX
 SG_ SIGNAL_46 : 312|2@1+ (1,0) [0|3] "" XXX
 SG_ SIGNAL_47 : 314|32@1+ (1,0) [0|255] "" XXX
 SG_ SIGNAL_48 : 346|6@1+ (1,0) [0|63] "" XXX
 SG_ SIGNAL_49 : 352|7@1+ (0.25,0) [0|127] "" XXX
 SG_ SIGNAL_50 : 359|6@1+ (0.03125,0) [0|31] "" XXX
 SG_ SIGNAL_51 : 365|10@1+ (0.125,0) [0|3] "" XXX
 SG_ SIGNAL_52 : 375|10@1+ (0.125,0) [0|63] "" XXX
 SG_ SIGNAL_53 : 385|7@1+ (1,0) [0|127] "" XXX
 SG_ SIGNAL_54 : 392|7@1+ (1,0) [0|127] "" XXX
 SG_ SIGNAL_55 : 399|8@1+ (0.00390625,0) [0|31] "" XXX
 SG_ SIGNAL_56 : 407|10@1+ (0.125,0) [0|63] "" XXX
 SG_ SIGNAL_57 : 417|1@1+ (1,0) [0|3] "" XXX
 SG_ SIGNAL_58 : 418|1@1+ (1,0) [0|3] "" XXX

BO_ 257 RADAR_POINTS_0x101: 64 RADAR
 SG_ MESSAGE_ID : 0|5@1+ (1,0) [0|31] "" XXX
 SG_ LAYOUT_ID : 5|2@1+ (1,0) [0|3] "" XXX
 SG_ POINT_1_DISTANCE : 7|14@1+ (0.015625,0) [0|255.984375] "" XXX
 SG_ POINT_1_SIGNAL_2 : 21|2@1+ (1,0) [0|3] "" XXX
 SG_ POINT_1_SIGNAL_3 : 23|8@1+ (0.001953125,-0.248046875) [-0.248046875|0.25] "" XXX
 SG_ POINT_1_REL_VELOCITY : 31|13@1+ (0.03125,-66) [-66|189.96875] "" XXX
 SG_ POINT_1_SIGNAL_5 : 44|2@1+ (1,0) [0|3] "" XXX
 SG_ POINT_1_SIGNAL_6 : 46|2@1+ (1,0) [0|3] "" XXX
 SG_ POINT_1_AZIMUTH : 48|12@1+ (0.001953125,-3.998046875) [-3.998046875|4.0] "" XXX
 SG_ POINT_1_SIGNAL_8 : 60|2@1+ (1,0) [0|3] "" XXX
 SG_ POINT_1_SIGNAL_9 : 62|1@1+ (1,0) [0|1] "" XXX
 SG_ POINT_1_SIGNAL_10 : 63|7@1+ (1,0) [0|127] "" XXX
 SG_ POINT_1_SIGNAL_11 : 70|1@1+ (1,0) [0|1] "" XXX
 SG_ POINT_1_SIGNAL_12 : 71|6@1+ (1,0) [0|63] "" XXX
 SG_ POINT_1_SIGNAL_13 : 77|2@1+ (1,0) [0|3] "" XXX
 SG_ POINT_1_SIGNAL_14 : 79|8@1+ (0.001953125,-0.248046875) [-0.248046875|0.25] "" XXX
 SG_ POINT_1_SIGNAL_15 : 87|1@1+ (1,0) [0|1] "" XXX
 SG_ POINT_1_SIGNAL_16 : 88|2@1+ (1,0) [0|3] "" XXX
 SG_ POINT_1_SIGNAL_17 : 90|3@1+ (1,0) [0|7] "" XXX
 SG_ POINT_1_SIGNAL_18 : 93|6@1+ (1,0) [0|63] "" XXX
 SG_ POINT_1_SIGNAL_19 : 99|8@1+ (1,0) [0|255] "" XXX
 SG_ POINT_1_SIGNAL_20 : 107|1@1+ (1,0) [0|1] "" XXX
 SG_ POINT_2_DISTANCE : 108|14@1+ (0.015625,0) [0|255.984375] "" XXX
 SG_ POINT_2_SIGNAL_2 : 122|2@1+ (1,0) [0|3] "" XXX
 SG_ POINT_2_SIGNAL_3 : 124|8@1+ (0.001953125,-0.248046875) [-0.248046875|0.25] "" XXX
 SG_ POINT_2_REL_VELOCITY : 132|13@1+ (0.03125,-66) [-66|189.96875] "" XXX
 SG_ POINT_2_SIGNAL_5 : 145|2@1+ (1,0) [0|3] "" XXX
 SG_ POINT_2_SIGNAL_6 : 147|2@1+ (1,0) [0|3] "" XXX
 SG_ POINT_2_AZIMUTH : 149|12@1+ (0.001953125,-3.998046875) [-3.998046875|4.0] "" XXX
 SG_ POINT_2_SIGNAL_8 : 161|2@1+ (1,0) [0|3] "" XXX
 SG_ POINT_2_SIGNAL_9 : 163|1@1+ (1,0) [0|1] "" XXX
 SG_ POINT_2_SIGNAL_10 : 164|7@1+ (1,0) [0|127] "" XXX
 SG_ POINT_2_SIGNAL_11 : 171|1@1+ (1,0) [0|1] "" XXX
 SG_ POINT_2_SIGNAL_12 : 172|6@1+ (1,0) [0|63] "" XXX
 SG_ POINT_2_SIGNAL_13 : 178|2@1+ (1,0) [0|3] "" XXX
 SG_ POINT_2_SIGNAL_14 : 180|8@1+ (0.001953125,-0.248046875) [-0.248046875|0.25] "" XXX
 SG_ POINT_2_SIGNAL_15 : 188|1@1+ (1,0) [0|1] "" XXX
 SG_ POINT_2_SIGNAL_16 : 189|2@1+ (1,0) [0|3] "" XXX
 SG_ POINT_2_SIGNAL_17 : 191|3@1+ (1,0) [0|7] "" XXX
 SG_ POINT_2_SIGNAL_18 : 194|6@1+ (1,0) [0|63] "" XXX
 SG_ POINT_2_SIGNAL_19 : 200|8@1+ (1,0) [0|255] "" XXX
 SG_ POINT_2_SIGNAL_20 : 208|1@1+ (1,0) [0|1] "" XXX
 SG_ POINT_3_DISTANCE : 209|14@1+ (0.015625,0) [0|255.984375] "" XXX
 SG_ POINT_3_SIGNAL_2 : 223|2@1+ (1,0) [0|3] "" XXX
 SG_ POINT_3_SIGNAL_3 : 225|8@1+ (0.001953125,-0.248046875) [-0.248046875|0.25] "" XXX
 SG_ POINT_3_REL_VELOCITY : 233|13@1+ (0.03125,-66) [-66|189.96875] "" XXX
 SG_ POINT_3_SIGNAL_5 : 246|2@1+ (1,0) [0|3] "" XXX
 SG_ POINT_3_SIGNAL_6 : 248|2@1+ (1,0) [0|3] "" XXX
 SG_ POINT_3_AZIMUTH : 250|12@1+ (0.001953125,-3.998046875) [-3.998046875|4.0] "" XXX
 SG_ POINT_3_SIGNAL_8 : 262|2@1+ (1,0) [0|3] "" XXX
 SG_ POINT_3_SIGNAL_9 : 264|1@1+ (1,0) [0|1] "" XXX
 SG_ POINT_3_SIGNAL_10 : 265|7@1+ (1,0) [0|127] "" XXX
 SG_ POINT_3_SIGNAL_11 : 272|1@1+ (1,0) [0|1] "" XXX
 SG_ POINT_3_SIGNAL_12 : 273|6@1+ (1,0) [0|63] "" XXX
 SG_ POINT_3_SIGNAL_13 : 279|2@1+ (1,0) [0|3] "" XXX
 SG_ POINT_3_SIGNAL_14 : 281|8@1+ (0.001953125,-0.248046875) [-0.248046875|0.25] "" XXX
 SG_ POINT_3_SIGNAL_15 : 289|1@1+ (1,0) [0|1] "" XXX
 SG_ POINT_3_SIGNAL_16 : 290|2@1+ (1,0) [0|3] "" XXX
 SG_ POINT_3_SIGNAL_17 : 292|3@1+ (1,0) [0|7] "" XXX
 SG_ POINT_3_SIGNAL_18 : 295|6@1+ (1,0) [0|63] "" XXX
 SG_ POINT_3_SIGNAL_19 : 301|8@1+ (1,0) [0|255] "" XXX
 SG_ POINT_3_SIGNAL_20 : 309|1@1+ (1,0) [0|1] "" XXX
 SG_ POINT_4_DISTANCE : 310|14@1+ (0.015625,0) [0|255.984375] "" XXX
 SG_ POINT_4_SIGNAL_2 : 324|2@1+ (1,0) [0|3] "" XXX
 SG_ POINT_4_SIGNAL_3 : 326|8@1+ (0.001953125,-0.248046875) [-0.248046875|0.25] "" XXX
 SG_ POINT_4_REL_VELOCITY : 334|13@1+ (0.03125,-66) [-66|189.96875] "" XXX
 SG_ POINT_4_SIGNAL_5 : 347|2@1+ (1,0) [0|3] "" XXX
 SG_ POINT_4_SIGNAL_6 : 349|2@1+ (1,0) [0|3] "" XXX
 SG_ POINT_4_AZIMUTH : 351|12@1+ (0.001953125,-3.998046875) [-3.998046875|4.0] "" XXX
 SG_ POINT_4_SIGNAL_8 : 363|2@1+ (1,0) [0|3] "" XXX
 SG_ POINT_4_SIGNAL_9 : 365|1@1+ (1,0) [0|1] "" XXX
 SG_ POINT_4_SIGNAL_10 : 366|7@1+ (1,0) [0|127] "" XXX
 SG_ POINT_4_SIGNAL_11 : 373|1@1+ (1,0) [0|1] "" XXX
 SG_ POINT_4_SIGNAL_12 : 374|6@1+ (1,0) [0|63] "" XXX
 SG_ POINT_4_SIGNAL_13 : 380|2@1+ (1,0) [0|3] "" XXX
 SG_ POINT_4_SIGNAL_14 : 382|8@1+ (0.001953125,-0.248046875) [-0.248046875|0.25] "" XXX
 SG_ POINT_4_SIGNAL_15 : 390|1@1+ (1,0) [0|1] "" XXX
 SG_ POINT_4_SIGNAL_16 : 391|2@1+ (1,0) [0|3] "" XXX
 SG_ POINT_4_SIGNAL_17 : 393|3@1+ (1,0) [0|7] "" XXX
 SG_ POINT_4_SIGNAL_18 : 396|6@1+ (1,0) [0|63] "" XXX
 SG_ POINT_4_SIGNAL_19 : 402|8@1+ (1,0) [0|255] "" XXX
 SG_ POINT_4_SIGNAL_20 : 410|1@1+ (1,0) [0|1] "" XXX
 SG_ POINT_5_DISTANCE : 411|14@1+ (0.015625,0) [0|255.984375] "" XXX
 SG_ POINT_5_SIGNAL_2 : 425|2@1+ (1,0) [0|3] "" XXX
 SG_ POINT_5_SIGNAL_3 : 427|8@1+ (0.001953125,-0.248046875) [-0.248046875|0.25] "" XXX
 SG_ POINT_5_REL_VELOCITY : 435|13@1+ (0.03125,-66) [-66|189.96875] "" XXX
 SG_ POINT_5_SIGNAL_5 : 448|2@1+ (1,0) [0|3] "" XXX
 SG_ POINT_5_SIGNAL_6 : 450|2@1+ (1,0) [0|3] "" XXX
 SG_ POINT_5_AZIMUTH : 452|12@1+ (0.001953125,-3.998046875) [-3.998046875|4.0] "" XXX
 SG_ POINT_5_SIGNAL_8 : 464|2@1+ (1,0) [0|3] "" XXX
 SG_ POINT_5_SIGNAL_9 : 466|1@1+ (1,0) [0|1] "" XXX
 SG_ POINT_5_SIGNAL_10 : 467|7@1+ (1,0) [0|127] "" XXX
 SG_ POINT_5_SIGNAL_11 : 474|1@1+ (1,0) [0|1] "" XXX
 SG_ POINT_5_SIGNAL_12 : 475|6@1+ (1,0) [0|63] "" XXX
 SG_ POINT_5_SIGNAL_13 : 481|2@1+ (1,0) [0|3] "" XXX
 SG_ POINT_5_SIGNAL_14 : 483|8@1+ (0.001953125,-0.248046875) [-0.248046875|0.25] "" XXX
 SG_ POINT_5_SIGNAL_15 : 491|1@1+ (1,0) [0|1] "" XXX
 SG_ POINT_5_SIGNAL_16 : 492|2@1+ (1,0) [0|3] "" XXX
 SG_ POINT_5_SIGNAL_17 : 494|3@1+ (1,0) [0|7] "" XXX
 SG_ POINT_5_SIGNAL_18 : 497|6@1+ (1,0) [0|63] "" XXX
 SG_ POINT_5_SIGNAL_19 : 503|8@1+ (1,0) [0|255] "" XXX
 SG_ POINT_5_SIGNAL_20 : 511|1@1+ (1,0) [0|1] "" XXX

BO_ 513 RADAR_POINTS_0x201: 64 RADAR
 SG_ MESSAGE_ID : 0|5@1+ (1,0) [0|31] "" XXX
 SG_ LAYOUT_ID : 5|2@1+ (1,0) [0|3] "" XXX
 SG_ POINT_1_DISTANCE : 7|14@1+ (0.015625,0) [0|255.984375] "" XXX
 SG_ POINT_1_SIGNAL_2 : 21|2@1+ (1,0) [0|3] "" XXX
 SG_ POINT_1_SIGNAL_3 : 23|8@1+ (0.001953125,-0.248046875) [-0.248046875|0.25] "" XXX
 SG_ POINT_1_REL_VELOCITY : 31|13@1+ (0.03125,-66) [-66|189.96875] "" XXX
 SG_ POINT_1_SIGNAL_5 : 44|2@1+ (1,0) [0|3] "" XXX
 SG_ POINT_1_SIGNAL_6 : 46|2@1+ (1,0) [0|3] "" XXX
 SG_ POINT_1_AZIMUTH : 48|12@1+ (0.001953125,-3.998046875) [-3.998046875|4.0] "" XXX
 SG_ POINT_1_SIGNAL_8 : 60|2@1+ (1,0) [0|3] "" XXX
 SG_ POINT_1_SIGNAL_9 : 62|1@1+ (1,0) [0|1] "" XXX
 SG_ POINT_1_SIGNAL_10 : 63|7@1+ (1,0) [0|127] "" XXX
 SG_ POINT_1_SIGNAL_11 : 70|1@1+ (1,0) [0|1] "" XXX
 SG_ POINT_1_SIGNAL_12 : 71|6@1+ (1,0) [0|63] "" XXX
 SG_ POINT_1_SIGNAL_13 : 77|2@1+ (1,0) [0|3] "" XXX
 SG_ POINT_1_SIGNAL_14 : 79|8@1+ (0.001953125,-0.248046875) [-0.248046875|0.25] "" XXX
 SG_ POINT_1_SIGNAL_15 : 87|1@1+ (1,0) [0|1] "" XXX
 SG_ POINT_1_SIGNAL_16 : 88|2@1+ (1,0) [0|3] "" XXX
 SG_ POINT_1_SIGNAL_17 : 90|3@1+ (1,0) [0|7] "" XXX
 SG_ POINT_1_SIGNAL_18 : 93|6@1+ (1,0) [0|63] "" XXX
 SG_ POINT_1_SIGNAL_19 : 99|8@1+ (1,0) [0|255] "" XXX
 SG_ POINT_1_SIGNAL_20 : 107|1@1+ (1,0) [0|1] "" XXX
 SG_ POINT_2_DISTANCE : 108|14@1+ (0.015625,0) [0|255.984375] "" XXX
 SG_ POINT_2_SIGNAL_2 : 122|2@1+ (1,0) [0|3] "" XXX
 SG_ POINT_2_SIGNAL_3 : 124|8@1+ (0.001953125,-0.248046875) [-0.248046875|0.25] "" XXX
 SG_ POINT_2_REL_VELOCITY : 132|13@1+ (0.03125,-66) [-66|189.96875] "" XXX
 SG_ POINT_2_SIGNAL_5 : 145|2@1+ (1,0) [0|3] "" XXX
 SG_ POINT_2_SIGNAL_6 : 147|2@1+ (1,0) [0|3] "" XXX
 SG_ POINT_2_AZIMUTH : 149|12@1+ (0.001953125,-3.998046875) [-3.998046875|4.0] "" XXX
 SG_ POINT_2_SIGNAL_8 : 161|2@1+ (1,0) [0|3] "" XXX
 SG_ POINT_2_SIGNAL_9 : 163|1@1+ (1,0) [0|1] "" XXX
 SG_ POINT_2_SIGNAL_10 : 164|7@1+ (1,0) [0|127] "" XXX
 SG_ POINT_2_SIGNAL_11 : 171|1@1+ (1,0) [0|1] "" XXX
 SG_ POINT_2_SIGNAL_12 : 172|6@1+ (1,0) [0|63] "" XXX
 SG_ POINT_2_SIGNAL_13 : 178|2@1+ (1,0) [0|3] "" XXX
 SG_ POINT_2_SIGNAL_14 : 180|8@1+ (0.001953125,-0.248046875) [-0.248046875|0.25] "" XXX
 SG_ POINT_2_SIGNAL_15 : 188|1@1+ (1,0) [0|1] "" XXX
 SG_ POINT_2_SIGNAL_16 : 189|2@1+ (1,0) [0|3] "" XXX
 SG_ POINT_2_SIGNAL_17 : 191|3@1+ (1,0) [0|7] "" XXX
 SG_ POINT_2_SIGNAL_18 : 194|6@1+ (1,0) [0|63] "" XXX
 SG_ POINT_2_SIGNAL_19 : 200|8@1+ (1,0) [0|255] "" XXX
 SG_ POINT_2_SIGNAL_20 : 208|1@1+ (1,0) [0|1] "" XXX
 SG_ POINT_3_DISTANCE : 209|14@1+ (0.015625,0) [0|255.984375] "" XXX
 SG_ POINT_3_SIGNAL_2 : 223|2@1+ (1,0) [0|3] "" XXX
 SG_ POINT_3_SIGNAL_3 : 225|8@1+ (0.001953125,-0.248046875) [-0.248046875|0.25] "" XXX
 SG_ POINT_3_REL_VELOCITY : 233|13@1+ (0.03125,-66) [-66|189.96875] "" XXX
 SG_ POINT_3_SIGNAL_5 : 246|2@1+ (1,0) [0|3] "" XXX
 SG_ POINT_3_SIGNAL_6 : 248|2@1+ (1,0) [0|3] "" XXX
 SG_ POINT_3_AZIMUTH : 250|12@1+ (0.001953125,-3.998046875) [-3.998046875|4.0] "" XXX
 SG_ POINT_3_SIGNAL_8 : 262|2@1+ (1,0) [0|3] "" XXX
 SG_ POINT_3_SIGNAL_9 : 264|1@1+ (1,0) [0|1] "" XXX
 SG_ POINT_3_SIGNAL_10 : 265|7@1+ (1,0) [0|127] "" XXX
 SG_ POINT_3_SIGNAL_11 : 272|1@1+ (1,0) [0|1] "" XXX
 SG_ POINT_3_SIGNAL_12 : 273|6@1+ (1,0) [0|63] "" XXX
 SG_ POINT_3_SIGNAL_13 : 279|2@1+ (1,0) [0|3] "" XXX
 SG_ POINT_3_SIGNAL_14 : 281|8@1+ (0.001953125,-0.248046875) [-0.248046875|0.25] "" XXX
 SG_ POINT_3_SIGNAL_15 : 289|1@1+ (1,0) [0|1] "" XXX
 SG_ POINT_3_SIGNAL_16 : 290|2@1+ (1,0) [0|3] "" XXX
 SG_ POINT_3_SIGNAL_17 : 292|3@1+ (1,0) [0|7] "" XXX
 SG_ POINT_3_SIGNAL_18 : 295|6@1+ (1,0) [0|63] "" XXX
 SG_ POINT_3_SIGNAL_19 : 301|8@1+ (1,0) [0|255] "" XXX
 SG_ POINT_3_SIGNAL_20 : 309|1@1+ (1,0) [0|1] "" XXX
 SG_ POINT_4_DISTANCE : 310|14@1+ (0.015625,0) [0|255.984375] "" XXX
 SG_ POINT_4_SIGNAL_2 : 324|2@1+ (1,0) [0|3] "" XXX
 SG_ POINT_4_SIGNAL_3 : 326|8@1+ (0.001953125,-0.248046875) [-0.248046875|0.25] "" XXX
 SG_ POINT_4_REL_VELOCITY : 334|13@1+ (0.03125,-66) [-66|189.96875] "" XXX
 SG_ POINT_4_SIGNAL_5 : 347|2@1+ (1,0) [0|3] "" XXX
 SG_ POINT_4_SIGNAL_6 : 349|2@1+ (1,0) [0|3] "" XXX
 SG_ POINT_4_AZIMUTH : 351|12@1+ (0.001953125,-3.998046875) [-3.998046875|4.0] "" XXX
 SG_ POINT_4_SIGNAL_8 : 363|2@1+ (1,0) [0|3] "" XXX
 SG_ POINT_4_SIGNAL_9 : 365|1@1+ (1,0) [0|1] "" XXX
 SG_ POINT_4_SIGNAL_10 : 366|7@1+ (1,0) [0|127] "" XXX
 SG_ POINT_4_SIGNAL_11 : 373|1@1+ (1,0) [0|1] "" XXX
 SG_ POINT_4_SIGNAL_12 : 374|6@1+ (1,0) [0|63] "" XXX
 SG_ POINT_4_SIGNAL_13 : 380|2@1+ (1,0) [0|3] "" XXX
 SG_ POINT_4_SIGNAL_14 : 382|8@1+ (0.001953125,-0.248046875) [-0.248046875|0.25] "" XXX
 SG_ POINT_4_SIGNAL_15 : 390|1@1+ (1,0) [0|1] "" XXX
 SG_ POINT_4_SIGNAL_16 : 391|2@1+ (1,0) [0|3] "" XXX
 SG_ POINT_4_SIGNAL_17 : 393|3@1+ (1,0) [0|7] "" XXX
 SG_ POINT_4_SIGNAL_18 : 396|6@1+ (1,0) [0|63] "" XXX
 SG_ POINT_4_SIGNAL_19 : 402|8@1+ (1,0) [0|255] "" XXX
 SG_ POINT_4_SIGNAL_20 : 410|1@1+ (1,0) [0|1] "" XXX
 SG_ POINT_5_DISTANCE : 411|14@1+ (0.015625,0) [0|255.984375] "" XXX
 SG_ POINT_5_SIGNAL_2 : 425|2@1+ (1,0) [0|3] "" XXX
 SG_ POINT_5_SIGNAL_3 : 427|8@1+ (0.001953125,-0.248046875) [-0.248046875|0.25] "" XXX
 SG_ POINT_5_REL_VELOCITY : 435|13@1+ (0.03125,-66) [-66|189.96875] "" XXX
 SG_ POINT_5_SIGNAL_5 : 448|2@1+ (1,0) [0|3] "" XXX
 SG_ POINT_5_SIGNAL_6 : 450|2@1+ (1,0) [0|3] "" XXX
 SG_ POINT_5_AZIMUTH : 452|12@1+ (0.001953125,-3.998046875) [-3.998046875|4.0] "" XXX
 SG_ POINT_5_SIGNAL_8 : 464|2@1+ (1,0) [0|3] "" XXX
 SG_ POINT_5_SIGNAL_9 : 466|1@1+ (1,0) [0|1] "" XXX
 SG_ POINT_5_SIGNAL_10 : 467|7@1+ (1,0) [0|127] "" XXX
 SG_ POINT_5_SIGNAL_11 : 474|1@1+ (1,0) [0|1] "" XXX
 SG_ POINT_5_SIGNAL_12 : 475|6@1+ (1,0) [0|63] "" XXX
 SG_ POINT_5_SIGNAL_13 : 481|2@1+ (1,0) [0|3] "" XXX
 SG_ POINT_5_SIGNAL_14 : 483|8@1+ (0.001953125,-0.248046875) [-0.248046875|0.25] "" XXX
 SG_ POINT_5_SIGNAL_15 : 491|1@1+ (1,0) [0|1] "" XXX
 SG_ POINT_5_SIGNAL_16 : 492|2@1+ (1,0) [0|3] "" XXX
 SG_ POINT_5_SIGNAL_17 : 494|3@1+ (1,0) [0|7] "" XXX
 SG_ POINT_5_SIGNAL_18 : 497|6@1+ (1,0) [0|63] "" XXX
 SG_ POINT_5_SIGNAL_19 : 503|8@1+ (1,0) [0|255] "" XXX
 SG_ POINT_5_SIGNAL_20 : 511|1@1+ (1,0) [0|1] "" XXX

BO_ 260 RADAR_POINTS_CHECKSUM_0x104: 3 RADAR
 SG_ CRC16 : 0|16@1+ (1,0) [0|65535] "" XXX

BO_ 516 RADAR_POINTS_CHECKSUM_0x204: 3 RADAR
 SG_ CRC16 : 0|16@1+ (1,0) [0|65535] "" XXX
